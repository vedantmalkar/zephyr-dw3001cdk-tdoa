## CMakeLists.txt
```
cmake_minimum_required(VERSION 3.20)

set(BOARD decawave_dwm3001cdk)

set(DTS_ROOT "${CMAKE_CURRENT_SOURCE_DIR}")
get_filename_component(REPO_ROOT "${CMAKE_CURRENT_SOURCE_DIR}/../.." ABSOLUTE)
list(APPEND DTS_ROOT "${REPO_ROOT}")

find_package(Zephyr REQUIRED HINTS $ENV{ZEPHYR_BASE})
project(ble_tx_timestamps)

add_subdirectory(../../drivers/dw3000 dw3000)

target_include_directories(app PRIVATE
    ../../drivers/dw3000/inc
    ../../drivers/platform
)

target_sources(app PRIVATE
    src/main.c
    ../../drivers/platform/dw3000_spi.c
    ../../drivers/platform/dw3000_hw.c
    ../../drivers/platform/port.c
    ../../drivers/platform/deca_port.c
)
```

## prj.conf
```kconfig
CONFIG_BT=y
CONFIG_BT_PERIPHERAL=y
CONFIG_BT_DEVICE_NAME="DWM3001-TXTS"
CONFIG_BT_DEVICE_APPEARANCE=0
CONFIG_BT_MAX_CONN=1
CONFIG_BT_MAX_PAIRED=1
CONFIG_BT_GATT_DYNAMIC_DB=n
CONFIG_BT_GATT_CLIENT=y
CONFIG_BT_RX_STACK_SIZE=2048
CONFIG_BT_L2CAP_TX_MTU=247
CONFIG_BT_BUF_ACL_TX_SIZE=251
CONFIG_BT_BUF_ACL_RX_SIZE=251
CONFIG_SPI=y
CONFIG_GPIO=y
CONFIG_UART_CONSOLE=y
CONFIG_PRINTK=y
CONFIG_LOG=y
CONFIG_LOG_DEFAULT_LEVEL=3
CONFIG_LOG_MODE_IMMEDIATE=y
CONFIG_MAIN_STACK_SIZE=4096
CONFIG_SYSTEM_WORKQUEUE_STACK_SIZE=2048
CONFIG_HEAP_MEM_POOL_SIZE=8192

CONFIG_FPU=y
CONFIG_FPU_SHARING=y
```

## src/main.c
```c
/*
 * BLE TX Timestamp Streamer - DWM3001CDK
 *
 * Transmits a UWB blink every 100 ms, reads the 40-bit hardware TX timestamp,
 * prints it on the serial console, and sends it to a connected laptop over BLE
 * (Nordic UART Service - TX notify characteristic).
 */

#include <zephyr/kernel.h>
#include <zephyr/logging/log.h>
#include <zephyr/bluetooth/bluetooth.h>
#include <zephyr/bluetooth/conn.h>
#include <zephyr/bluetooth/uuid.h>
#include <zephyr/bluetooth/gatt.h>

#include "deca_device_api.h"
#include "deca_probe_interface.h"
#include "dw3000_hw.h"
#include "port.h"

LOG_MODULE_REGISTER(ble_tx_ts, LOG_LEVEL_INF);

struct ts_entry {
	uint8_t  seq;
	uint64_t tx_ts;
};

K_MSGQ_DEFINE(ts_queue, sizeof(struct ts_entry), 32, 4);

#define BT_UUID_NUS_VAL \
	BT_UUID_128_ENCODE(0x6E400001, 0xB5A3, 0xF393, 0xE0A9, 0xE50E24DCCA9EULL)
#define BT_UUID_NUS_TX_VAL \
	BT_UUID_128_ENCODE(0x6E400003, 0xB5A3, 0xF393, 0xE0A9, 0xE50E24DCCA9EULL)

static struct bt_uuid_128 nus_uuid    = BT_UUID_INIT_128(BT_UUID_NUS_VAL);
static struct bt_uuid_128 nus_tx_uuid = BT_UUID_INIT_128(BT_UUID_NUS_TX_VAL);

static struct bt_conn *current_conn;
static bool notify_enabled;

static void tx_ccc_changed(const struct bt_gatt_attr *attr, uint16_t value)
{
	notify_enabled = (value == BT_GATT_CCC_NOTIFY);
	LOG_INF("Notifications %s", notify_enabled ? "enabled" : "disabled");
}

BT_GATT_SERVICE_DEFINE(nus_svc,
	BT_GATT_PRIMARY_SERVICE(&nus_uuid),
	BT_GATT_CHARACTERISTIC(&nus_tx_uuid.uuid,
		BT_GATT_CHRC_NOTIFY,
		BT_GATT_PERM_NONE,
		NULL, NULL, NULL),
	BT_GATT_CCC(tx_ccc_changed, BT_GATT_PERM_READ | BT_GATT_PERM_WRITE),
);

#define TX_ATTR (&nus_svc.attrs[1])

static const struct bt_le_adv_param adv_param =
	BT_LE_ADV_PARAM_INIT(BT_LE_ADV_OPT_CONN,
			     BT_GAP_ADV_FAST_INT_MIN_2,
			     BT_GAP_ADV_FAST_INT_MAX_2,
			     NULL);

static const struct bt_data ad[] = {
	BT_DATA_BYTES(BT_DATA_FLAGS, (BT_LE_AD_GENERAL | BT_LE_AD_NO_BREDR)),
	BT_DATA_BYTES(BT_DATA_UUID128_ALL, BT_UUID_NUS_VAL),
};

static const struct bt_data sd[] = {
	BT_DATA(BT_DATA_NAME_COMPLETE, CONFIG_BT_DEVICE_NAME,
		sizeof(CONFIG_BT_DEVICE_NAME) - 1),
};

static void mtu_exchange_cb(struct bt_conn *conn, uint8_t err,
			    struct bt_gatt_exchange_params *params)
{
	if (err) {
		LOG_WRN("MTU exchange failed (err %u)", err);
	} else {
		LOG_INF("MTU exchanged: %u", bt_gatt_get_mtu(conn));
	}
}

static struct bt_gatt_exchange_params mtu_params = {
	.func = mtu_exchange_cb,
};

static void connected(struct bt_conn *conn, uint8_t err)
{
	if (err) {
		LOG_ERR("Connect failed (err %u)", err);
		return;
	}
	current_conn = bt_conn_ref(conn);
	LOG_INF("Connected");
	bt_gatt_exchange_mtu(conn, &mtu_params);
}

static void disconnected(struct bt_conn *conn, uint8_t reason)
{
	LOG_INF("Disconnected (reason %u)", reason);
	bt_conn_unref(current_conn);
	current_conn = NULL;
	notify_enabled = false;
	bt_le_adv_start(&adv_param, ad, ARRAY_SIZE(ad), sd, ARRAY_SIZE(sd));
}

BT_CONN_CB_DEFINE(conn_cb) = {
	.connected    = connected,
	.disconnected = disconnected,
};

static dwt_config_t uwb_cfg = {
	.chan           = 9,
	.txPreambLength = DWT_PLEN_128,
	.rxPAC          = DWT_PAC8,
	.txCode         = 9,
	.rxCode         = 9,
	.sfdType        = DWT_SFD_DW_8,
	.dataRate       = DWT_BR_6M8,
	.phrMode        = DWT_PHRMODE_STD,
	.phrRate        = DWT_PHRRATE_STD,
	.sfdTO          = (129 + 8 - 8),
	.stsMode        = DWT_STS_MODE_OFF,
	.stsLength      = DWT_STS_LEN_64,
	.pdoaMode       = DWT_PDOA_M0,
};

static int uwb_init(void)
{
	dw_device_init();
	dw3000_hw_wakeup_pin_low();
	Sleep(5);
	port_set_dw_ic_spi_slowrate();

	if (dwt_probe((struct dwt_probe_s *)&dw3000_probe_interf) != DWT_SUCCESS) {
		LOG_ERR("dwt_probe failed");
		return -1;
	}

	port_set_dw_ic_spi_fastrate();

	if (dwt_initialise(DWT_DW_INIT) != DWT_SUCCESS) {
		LOG_ERR("dwt_initialise failed");
		return -1;
	}

	if (dwt_configure(&uwb_cfg) != DWT_SUCCESS) {
		LOG_ERR("dwt_configure failed");
		return -1;
	}

	dwt_setrxantennadelay(16385);
	dwt_settxantennadelay(16385);

	return 0;
}

#define UWB_STACK_SIZE 4096
#define UWB_PRIORITY   5

static void uwb_tx_thread(void *a, void *b, void *c)
{
	ARG_UNUSED(a);
	ARG_UNUSED(b);
	ARG_UNUSED(c);

	LOG_INF("UWB TX thread started");

	uint8_t msg[] = {0xAB, 0xCD, 0x00};
	uint8_t ts_raw[5];
	uint8_t seq = 0;

	while (1) {
		msg[2] = seq;

		dwt_writetxdata(sizeof(msg), msg, 0);
		dwt_writetxfctrl(sizeof(msg) + FCS_LEN, 0, 0);
		dwt_starttx(DWT_START_TX_IMMEDIATE);

		while (!(dwt_readsysstatuslo() & DWT_INT_TXFRS_BIT_MASK)) {
		}

		dwt_readtxtimestamp(ts_raw);
		dwt_writesysstatuslo(DWT_INT_TXFRS_BIT_MASK);

		uint64_t ts = 0;

		for (int i = 4; i >= 0; i--) {
			ts = (ts << 8) | ts_raw[i];
		}

		struct ts_entry entry = {
			.seq   = seq,
			.tx_ts = ts,
		};

		if (k_msgq_put(&ts_queue, &entry, K_NO_WAIT) != 0) {
			k_msgq_purge(&ts_queue);
			k_msgq_put(&ts_queue, &entry, K_NO_WAIT);
		}

		seq++;
		k_msleep(100);
	}
}

K_THREAD_STACK_DEFINE(uwb_stack, UWB_STACK_SIZE);
static struct k_thread uwb_thread_data;

int main(void)
{
	LOG_INF("BLE TX Timestamp Streamer starting");

	if (uwb_init() != 0) {
		LOG_ERR("DW3000 init failed");
		return -1;
	}
	LOG_INF("DW3000 ready");
	k_thread_create(&uwb_thread_data, uwb_stack, UWB_STACK_SIZE,
			uwb_tx_thread, NULL, NULL, NULL,
			UWB_PRIORITY, 0, K_NO_WAIT);
	k_thread_name_set(&uwb_thread_data, "uwb_tx");

	if (bt_enable(NULL) != 0) {
		LOG_ERR("BLE enable failed");
		return -1;
	}
	LOG_INF("BLE ready");

	if (bt_le_adv_start(&adv_param, ad, ARRAY_SIZE(ad), sd, ARRAY_SIZE(sd)) != 0) {
		LOG_ERR("Advertising start failed");
		return -1;
	}
	LOG_INF("Advertising as \"%s\"", CONFIG_BT_DEVICE_NAME);

	struct ts_entry entry;
	char buf[32];

	while (1) {
		k_msgq_get(&ts_queue, &entry, K_FOREVER);

		int len = snprintf(buf, sizeof(buf), "seq=%u ts=%llu\n",
				   entry.seq, entry.tx_ts);

		printk("%s", buf);

		if (notify_enabled && current_conn) {
			bt_gatt_notify(current_conn, TX_ATTR, buf, len);
		}
	}

	return 0;
}
```
